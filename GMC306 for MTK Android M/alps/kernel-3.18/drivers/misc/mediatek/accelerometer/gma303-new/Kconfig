## GMC306 for MTK Android M/alps/kernel-3.18/drivers/misc/mediatek/accelerometer/gma303-new/Kconfig
```kconfig
config MTK_GMA303
	bool "GMA303 for MediaTek package"
	default n
	help
	  It support different accelerometer sensor.
          If this option is set,
	  it will support
          GMA303 Accelerometer.
```

## GMC306 for MTK Android M/alps/kernel-3.18/drivers/misc/mediatek/magnetometer/gmc303-new/Kconfig
```kconfig
config MTK_GMC303_NEW
        bool "MTK_GMC306_NEW for Mediatek package"
        default n
	help
	  It support different magnetometer sensor.
          If this option is set,
	  it will support
          GMC306 magnetometer.

config CUSTOM_KERNEL_SENSORHUB
        bool "MTK_GMC303 for Mediatek package SENSORHUB"
        default n
        help
        Say Y here if you have MTK_GMC303 touch panel CUSTOM_KERNEL_SENSORHUB.

        If unsure, say N.

        To compile this dirver as a module, choose M here: the
        module will be called.
```
